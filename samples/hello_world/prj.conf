## prj.conf
```kconfig
# nothing here
CONFIG_FLASH=y
```

## src/main.c
```c
/*
 * Copyright (c) 2012-2014 Wind River Systems, Inc.
 *
 * SPDX-License-Identifier: Apache-2.0
 */
#include <stdio.h>
#include <ti/driverlib/dl_crc.h>
#include <ti/driverlib/dl_flashctl.h>
#include <zephyr/storage/flash_map.h>
#include "l_bcrbsl.h"

#include <ti/driverlib/dl_crcp.h>

#define CRCP0	(CRCP_Regs *)CRCP0_BASE
#define FLASHCTL	(FLASHCTL_Regs *)FLASHCTL_BASE

#define BOOT_START	0x00000000

/* Base address of nonmain memory */
#define NONMAIN_BASE_ADDRESS                                      (0x41C00000U)

/* Base address of the BCR configuration structure in nonmain memory */
#define BCR_USER_CFG_BASE_ADDRESS                                 (0x41C00000U)

/* Base address of the BSL configuration structure in nonmain memory */
#define BSL_USER_CFG_BASE_ADDRESS                                 (0x41C00100U)

/* Size in bytes of the BSL and BCR configuration structures */
#define BCR_CONFIG_SIZE_BYTES                                            (184U)
#define BSL_CONFIG_SIZE_BYTES                                             (88U)

/* The calculated CRC based on the default configuration values */
#define BCR_CFG_DEFAULT_CRC                                        (0x3f6920b2)
#define BSL_CFG_DEFAULT_CRC                                        (0x6f014bd1)

#define MCUBOOT_START	FIXED_PARTITION_OFFSET(boot_partition)
#define MCUBOOT_LEN	FIXED_PARTITION_SIZE(boot_partition)

/* clang-format on */

/* The default configuration of the BCR config struct */
BCR_Config BCRConf = {
	.bcrConfigID                   = 0x1000002,
	.debugAccess                   = BCR_CFG_DEBUG_ACCESS_EN,
	.swdpMode                      = BCR_CFG_SWDP_EN,
	.tifaMode                      = BCR_CFG_TIFA_EN,
	.bslPinInvokeEnable            = BCR_CFG_BSL_PIN_INVOKE_EN,
	.staticWriteProtectionMainLow  = CFG_DEFAULT_VALUE,
	.staticWriteProtectionMainHigh = CFG_DEFAULT_VALUE,
	.staticWriteProtectionNonMain  = BCR_CFG_NON_MAIN_STATIC_PROT_DIS,
	.debugHold                     = BCR_CFG_DEBUG_HOLD_DIS,
	.CSCexist                      = BCR_CFG_CSC_NOT_EXIST,
	.flashBankSwapPolicy           = BCR_CFG_FLASH_BS_DIS,
	.fastBootMode                  = BCR_CFG_FAST_BOOT_DIS,
	.bootloaderMode                = BCR_CFG_BOOTLOADER_MODE_EN,
	.massEraseMode                 = BCR_CFG_MASS_ERASE_EN,
	.factoryResetMode              = BCR_CFG_FACTORY_RESET_EN,
	.passwordMassErase             = {CFG_DEFAULT_VALUE, CFG_DEFAULT_VALUE,
		CFG_DEFAULT_VALUE, CFG_DEFAULT_VALUE, CFG_DEFAULT_VALUE,
		CFG_DEFAULT_VALUE, CFG_DEFAULT_VALUE, CFG_DEFAULT_VALUE},
	.passwordFactoryReset          = {CFG_DEFAULT_VALUE, CFG_DEFAULT_VALUE,
		CFG_DEFAULT_VALUE, CFG_DEFAULT_VALUE, CFG_DEFAULT_VALUE,
		CFG_DEFAULT_VALUE, CFG_DEFAULT_VALUE, CFG_DEFAULT_VALUE},
	.passwordDebugLock             = {CFG_DEFAULT_VALUE, CFG_DEFAULT_VALUE,
		CFG_DEFAULT_VALUE, CFG_DEFAULT_VALUE, CFG_DEFAULT_VALUE,
		CFG_DEFAULT_VALUE, CFG_DEFAULT_VALUE, CFG_DEFAULT_VALUE},
	.bc_reserved_0                 = 0xFFFF,
	.secureBootMode                = BCR_CFG_SECURE_BOOT_DIS,
	.userSecureAppStartAddr        = CFG_DEFAULT_VALUE,
	.userSecureAppLength           = CFG_DEFAULT_VALUE,
	.userSecureAppHash             = {CFG_DEFAULT_VALUE, CFG_DEFAULT_VALUE,
		CFG_DEFAULT_VALUE, CFG_DEFAULT_VALUE, CFG_DEFAULT_VALUE,
		CFG_DEFAULT_VALUE, CFG_DEFAULT_VALUE, CFG_DEFAULT_VALUE},
	.bc_reserved_1                 = 0xFFFFFFFFU,
	.userCfgCRC                    = BCR_CFG_DEFAULT_CRC,
};

uint32_t calcUserConfigCRC(uint8_t *dataPointer, uint32_t size)
{
	static uint32_t i;

	uint32_t calculatedCRC;

	DL_CRCP_init(CRCP0, DL_CRCP_POLYNOMIAL_SIZE_32, DL_CRCP_BIT_REVERSED,
		     DL_CRCP_INPUT_ENDIANESS_LITTLE_ENDIAN,
		     DL_CRCP_OUTPUT_BYTESWAP_DISABLED);

	/* Set the Seed value to reset the calculation */
	DL_CRCP_setSeed32(CRCP0, CRCP_SEED);

	for (i = (uint32_t) 0U; i < size; i++) {
		DL_CRCP_feedData8(CRCP0, dataPointer[i]);
	}
	calculatedCRC = DL_CRCP_getResult32(CRCP0);

	return calculatedCRC;
}

int main(void)
{
	DL_CRCP_enablePower(CRCP0);

	/* mark as csc exist to stop initdone issue after BCR */
	BCRConf.CSCexist = BCR_CFG_CSC_EXIST;

	/* unprotect NONMAIN, and then erase NONMAIN memory */
	DL_FlashCTL_executeClearStatus(FLASHCTL);
	DL_FlashCTL_unprotectSector(FLASHCTL, NONMAIN_BASE_ADDRESS, DL_FLASHCTL_REGION_SELECT_NONMAIN);
	DL_FlashCTL_eraseMemoryFromRAM(FLASHCTL, NONMAIN_BASE_ADDRESS, DL_FLASHCTL_COMMAND_SIZE_SECTOR);

	DL_FlashCTL_programMemoryBlockingFromRAM64WithECCGenerated(FLASHCTL,
								   BCR_USER_CFG_BASE_ADDRESS, (uint32_t *) &BCRConf,
								   (BCR_CONFIG_SIZE_BYTES / 4), DL_FLASHCTL_REGION_SELECT_NONMAIN);
	/* Protect flash nonmain region */
	DL_FlashCTL_protectNonMainMemory(FLASHCTL);

	printf("\nBcr config completed");

	return 0;
}
```

## src/g_bcrbsl.h
```c
#ifndef boot_config_h
#define boot_config_h
/* clang-format off */

/* General defines */
#define PASSWORD_WORD_LEN                                                  (4U)

/*! The default value used in the BCR and BSL Config structures */
#define CFG_DEFAULT_VALUE                                         (0xFFFFFFFFU)

/**
 * @brief Possible values used for BCR configuration struct
 */

/*! @enum BCR_CFG_DEBUG_ACCESS */
typedef enum {
	/*! AHB-AP, ET-AP, PWR-AP are enabled */
	BCR_CFG_DEBUG_ACCESS_EN = 0xAABBU,
	/*! AHB-AP, ET-AP, PWR-AP are enabled with password through DSSM */
	BCR_CFG_DEBUG_ACCESS_EN_PW = 0xCCDDU,
} BCR_CFG_DEBUG_ACCESS;

/*! @enum BCR_CFG_SWDP_MODE */
typedef enum {
	/*! SWD port access is enabled */
	BCR_CFG_SWDP_EN = 0xAABBU,
	/*! SWD port access is disabled */
	BCR_CFG_SWDP_DIS = 0xFFFFU,
} BCR_CFG_SWDP_MODE;

/*! @enum BCR_CFG_TIFA_MODE */
typedef enum {
	/*! If enabled, re-test request through DSSM is serviced */
	BCR_CFG_TIFA_EN = 0xAABBU,
	/*! Re-test request through DSSM is not serviced */
	BCR_CFG_TIFA_DIS = 0xFFFFU,
} BCR_CFG_TIFA_MODE;

/*! @enum BCR_CFG_BSL_PIN_INVOKE */
typedef enum {
	/*! GPIO based BSL invocation check will be executed */
	BCR_CFG_BSL_PIN_INVOKE_EN = 0xAABBU,
	/*! GPIO based BSL invocation check will not be executed */
	BCR_CFG_BSL_PIN_INVOKE_DIS = 0xFFFFU,
} BCR_CFG_BSL_PIN_INVOKE;

/*! @enum BCR_CFG_FAST_BOOT */
typedef enum {
	/*! If enabled, checks only the register invoke condition and skips other
	 *  BSL invoke conditions */
	BCR_CFG_FAST_BOOT_EN = 0xAABBU,
	/*! If disabled, all enabled BSL invoke conditions are evaluated */
	BCR_CFG_FAST_BOOT_DIS = 0xFFFFU,
} BCR_CFG_FAST_BOOT;

/*! @enum BCR_CFG_BOOTLOADER_MODE */
typedef enum {
	/*! Enable Bootloader mode */
	BCR_CFG_BOOTLOADER_MODE_EN = 0xAABBU,
	/*! Disable Bootloader mode */
	BCR_CFG_BOOTLOADER_MODE_DIS = 0xFFFFU,
} BCR_CFG_BOOTLOADER_MODE;

/*! @enum BCR_CFG_MASS_ERASE */
typedef enum {
	/*! Enable Mass Erase without password */
	BCR_CFG_MASS_ERASE_EN = 0xAABBU,
	/*! Enable Mass Erase with password */
	BCR_CFG_MASS_ERASE_EN_PW = 0xCCDDU,
	/*! Disable Mass Erase */
	BCR_CFG_MASS_ERASE_DIS = 0xFFFFU,
} BCR_CFG_MASS_ERASE;

/*! @enum BCR_CFG_FACTORY_RESET */
typedef enum {
	/*! Enable Factory Reset without password */
	BCR_CFG_FACTORY_RESET_EN = 0xAABBU,
	/*! Enable Factory Reset with password */
	BCR_CFG_FACTORY_RESET_EN_PW = 0xCCDDU,
	/*! Disable Factory Reset */
	BCR_CFG_FACTORY_RESET_DIS = 0xFFFFU,
} BCR_CFG_FACTORY_RESET;

/*! @enum BCR_CFG_NON_MAIN_STATIC_PROT */
typedef enum {
	/*! Enable static write protection for non-main memory */
	BCR_CFG_NON_MAIN_STATIC_PROT_EN = 0xFFFEU,
	/*! Disable static write protection for non-main memory */
	BCR_CFG_NON_MAIN_STATIC_PROT_DIS = 0xFFFFU,
} BCR_CFG_NON_MAIN_STATIC_PROT;

/*! @enum BCR_CFG_SECURE_BOOT */
typedef enum {
	/*! Enable CRC check part of application */
	BCR_CFG_SECURE_BOOT_EN = 0xAABBU,
	/*! Disable CRC check part of application */
	BCR_CFG_SECURE_BOOT_DIS = 0xFFFFU,
} BCR_CFG_SECURE_BOOT;

/* Bootcode user configuration structure */
typedef struct
{
	/*! Configuration signature */
	uint32_t bcrConfigID;
	/*! Enable/disable AHB-AP, ET-AP, PWR-AP.
	 * One of @ref BCR_CFG_DEBUG_ACCESS */
	BCR_CFG_DEBUG_ACCESS debugAccess;
	/*! Enable/disable SWD port access. One of @ref BCR_CFG_SWDP_MODE */
	BCR_CFG_SWDP_MODE swdpMode;
	/*! Enable/disable servicing re-test request through DSSM.
	 * One of @ref BCR_CFG_TIFA_MODE */
	BCR_CFG_TIFA_MODE tifaMode;
	/*! Enable/disable BSL pin invocation.
	 * One of @ref BCR_CFG_BSL_PIN_INVOKE */
	BCR_CFG_BSL_PIN_INVOKE bslPinInvokeEnable;
	/*! Used with Command DSSM_BC_PW_AUTH_REQUEST */
	uint32_t passwordDebugLock [PASSWORD_WORD_LEN];
	/*! The fast boot mode. One of @ref BCR_CFG_FAST_BOOT*/
	BCR_CFG_FAST_BOOT fastBootMode;
	/*! The bootloader mode. One of @ref BCR_CFG_BOOTLOADER_MODE */
	BCR_CFG_BOOTLOADER_MODE bootloaderMode;
	/*! The mass erase mode. One of @ref BCR_CFG_MASS_ERASE */
	BCR_CFG_MASS_ERASE massEraseMode;
	/*! The factory reset mode. One of @ref BCR_CFG_FACTORY_RESET */
	BCR_CFG_FACTORY_RESET factoryResetMode;
	/*! DSSM_BC_MASS_ERASE_REQUEST, DSSM_DATA_EXCHANGE */
	uint32_t passwordMassErase [PASSWORD_WORD_LEN];
	/*! DSSM_BC_FACTORY_RESET_REQUEST, DSSM_DATA_EXCHANGE */
	uint32_t passwordFactoryReset [PASSWORD_WORD_LEN];
	/*! Programs static write protection of first 32K bytes.
	 * One bit corresponds to one sector, LSB is Sector 0. Setting a bit
	 * to 0 disables write, setting a bit to 1 enables write Possible values:
	 *    - 0x0 to 0xFFFFFFFF */
	uint32_t staticWriteProtectionMainLow;
	/*! Programs static write protection of first 32K bytes.
	 * One bit corresponds to eight sectors. Setting a bit
	 * to 0 disables write, setting a bit to 1 enables write Possible values:
	 *    - 0x0 to 0xFFFFFFF0 */
	uint32_t staticWriteProtectionMainHigh;
	/*! Non Main Flash Static Write Protection.
	 * One of @ref BCR_CFG_NON_MAIN_STATIC_PROT */
	BCR_CFG_NON_MAIN_STATIC_PROT staticWriteProtectionNonMain;
	/*! CRC check part of the application. One of @ref BCR_CFG_SECURE_BOOT */
	BCR_CFG_SECURE_BOOT secureBootMode;
	/*! The Starting address from where CRC has to be calculated for the application */
	uint32_t userSecureAppStartAddr;
	/*! The Length of the application for which CRC is calculated */
	uint32_t userSecureAppLength;
	/*! CRC-32 of application range defined by above two parameters */
	uint32_t userSecureAppCrc;
	/*! CRC-32 of this structure*/
	uint32_t userCfgCRC;
} BCR_Config;

/* Structure to store the Bootloader UART and I2C Pin details. */
typedef struct
{
	uint8_t UART_RXD_pad_num;
	uint8_t UART_RXD_PF_mux_sel;
	uint8_t UART_TXD_pad_num;
	uint8_t UART_TXD_PF_mux_sel;
	uint8_t I2C_SDA_pad_num;
	uint8_t I2C_SDA_PF_mux_sel;
	uint8_t I2C_SCL_pad_num;
	uint8_t I2C_SCL_PF_mux_sel;
} BSLInterfacePins;

/* Structure to store the Bootloader invocation Pin details.
 * This structure is followed in TRIM memory where default BSL invocation
 * pin details are stored and also in Bootloader configuration memory.
 * See BSL_CFG_INVOKE_PIN defines for more details on mask widths and offsets.
 *
 * Pin_data_0
 * pincmIndex   -> IOMUX_SECCFG_PINCM index for the pin. See device datasheet
 *                 for index range
 * pinLevel     -> Pin state High(1)/ Low(0) which should be
 *                 considered as BSL invocation condition
 * Pin_data_1
 * gpioNum      -> GPIO Pin number (0 to 31)
 * gpioBase     -> GPIO Instance number (GPIO Base Index or GPIO Port). See
 *                 device datasheet for ports available on the device. Port A
 *                 is 0, port B is 1, etc.
 */
typedef struct
{
	uint8_t pinData0;
	uint8_t pinData1;
} BSLInvokePin;

/**
 * @brief Possible values used for BSL configuration struct
 */

/*! Mask for BSLInvokePin.pinData0 to get IOMUX_PINCM */
#define BSL_CFG_INVOKE_PIN_PINCM_INDEX_MASK                             (0x3FU)
#define BSL_CFG_INVOKE_PIN_PINCM_INDEX_POS                                 (0U)

/*! Mask for BSLInvokePin.pinData0 to get the pin state, which determines the
 * Bootloader invocation condition) */
#define BSL_CFG_INVOKE_PIN_LEVEL_MASK                                   (0x80U)
#define BSL_CFG_INVOKE_PIN_LEVEL_POS                                       (7U)

/*! Mask for BSLInvokePin.pinData1 to get GPIO pin number */
#define BSL_CFG_INVOKE_PIN_GPIO_PIN_NUM_MASK                            (0x1FU)
#define BSL_CFG_INVOKE_PIN_GPIO_PIN_NUM_POS                                (0U)

/*! Mask for BSLInvokePin.pinData1 to get GPIO Base Index */
#define BSL_CFG_INVOKE_PIN_GPIO_PORT_NUM_MASK                           (0x20U)
#define BSL_CFG_INVOKE_PIN_GPIO_PORT_NUM_POS                               (5U)

/*! @enum BSL_CFG_MEMORY_READOUT */
typedef enum {
	/*! Memory readout is enabled */
	BSL_CFG_MEMORY_READOUT_ENABLE = 0xAABBU,
	/*! Memory readout is disabled */
	BSL_CFG_MEMORY_READOUT_DISABLE = 0xFFFFU,
} BSL_CFG_MEMORY_READOUT;

/*! @enum BSL_CFG_NRST */
typedef enum {
	/*! NRST is disabled during bootloader execution */
	BSL_CFG_NRST_DISABLE = 0xAABBU,
	/*! NRST is enabled during bootloader execution */
	BSL_CFG_NRST_ENABLE = 0xFFFFU,
} BSL_CFG_NRST;

/*! @enum BSL_CFG_PLUGIN_TYPE */
typedef enum {
	/*! Plugin type in Flash is UART */
	BSL_CFG_PLUGIN_TYPE_UART = 0x1000U,
	/*! Plugin type in Flash is I2C */
	BSL_CFG_PLUGIN_TYPE_I2C = 0x2000U,
	/*! Any other interface with valid hooks will be added to the plugin
	 * list */
	BSL_CFG_PLUGIN_TYPE_ANY = 0xFFFFU,
} BSL_CFG_PLUGIN_TYPE;

/*! @enum BSL_CFG_PLUGIN_FLASH */
typedef enum {
	/*! Flash plugin will be used */
	BSL_CFG_PLUGIN_FLASH_EXIST = 0xBBU,
	/*! Only ROM plugins will be used */
	BSL_CFG_PLUGIN_FLASH_NOT_EXIST = 0xFFU,
} BSL_CFG_PLUGIN_FLASH;

/*! @enum BSL_CFG_FLASH_BSL */
typedef enum {
	/*! Secondary BSL does exist */
	BSL_CFG_FLASH_BSL_EXIST = 0xAABBU,
	/*! Secondary BSL does not exist */
	BSL_CFG_FLASH_BSL_NOT_EXIST = 0xFFFFU,
} BSL_CFG_FLASH_BSL;

/*! @enum BSL_CFG_SECURITY */
typedef enum {
	/*! Factory reset performed on security alert */
	BSL_CFG_SECURITY_FACTORY_RESET = 0xAABBU,
	/*! BSL disabled on security alert */
	BSL_CFG_SECURITY_DISABLE_BSL = 0xCCDDU,
	/*! Ignore security alert */
	BSL_CFG_SECURITY_IGNORE = 0xFFFFU,
} BSL_CFG_SECURITY;

/**
 * @brief Bootstrap loader (BSL) configuration structure values.
 * See BSL_CFG defines for possible values.
 */
typedef struct
{
	/*! Predetermined config signature magic ID */
	uint32_t configID;
	/*! BSL interface pins. Static Default BSL invocation Pin details are
	 * as per TRIM open AREA default. */
	BSLInterfacePins interfacePins;
	/*! BSL pin invocation. Static Default BSL invocation Pin details are
	 * as per TRIM open Area default. */
	BSLInvokePin pin;
	/*! Enable/disable memory readout. One of @ref BSL_CFG_MEMORY_READOUT */
	BSL_CFG_MEMORY_READOUT memoryRead;
	/*! Bootloader 64-byte password */
	uint32_t password[8];
	/*! Plugin type. One of @ref BSL_CFG_PLUGIN_TYPE */
	BSL_CFG_PLUGIN_TYPE pluginType;
	/*! Enable use of Flash plugin or ROM plugin.
	 * One of @ref BSL_CFG_PLUGIN_FLASH */
	BSL_CFG_PLUGIN_FLASH flashPluginEnable;
	/*! SRAM memory consumed by the Flash Plugin. Range from 0x00 to 0xFF*/
	uint8_t pluginSramSize;
	/*! Function pointers for Flash Plugins.
	 *   - Byte [3-0] : Init
	 *   - Byte [7-4] : Receive
	 *   - Byte [11-8] : Send
	 *   - Byte [15-12] : Deinit */
	uint32_t pluginHook[4];
	/*! ID field to enable invocation of an alternate BSL.
	 * One of @ref BSL_CFG_FLASH_BSL */
	BSL_CFG_FLASH_BSL  BSLAlternateConfig;
	/*! Reserved */
	uint16_t reserved;
	/*! Address of the alternate BSL */
	uint32_t  BSLAlternateAddr;
	/*! Pointer to the version information in MAIN flash. Possible values:
	 *    - Valid Flash Address
	 *    - All other values: Address will not be accessed */
	uint32_t* appRev;
	/*! Security alert configuration. One of @ref BSL_CFG_SECURITY */
	BSL_CFG_SECURITY securityAlert;
	/* I2C slave address to be used for BSL I2C communication. Any 7-bit value */
	uint16_t i2cSlaveAddress;
	/*! CRC of this BSL_Config structure */
	uint32_t userCfgCRC;
} BSL_Config;

/* Added for secondary_bsl to build */
extern const BSL_Config BSLConfig;
extern const BCR_Config BCRConfig;

/* clang-format on */

#endif /* boot_config_h */
```

## src/l_bcrbsl.h
```c
#ifndef boot_config_l_h
#define boot_config_l_h

/* Defines for CRC */
#define CRCP_SEED                                                   (0xFFFFFFFF)
/* Redirects to CRCP_SEED for compatibility between CRC and CRCP modules */
#define CRC_SEED                                                       CRCP_SEED


/* General defines */
#define PASSWORD_WORD_LEN                                                  (8U)

/*! The default value used in the BCR and BSL Config structures */
#define CFG_DEFAULT_VALUE                                         (0xFFFFFFFFU)

/**
 * @brief Possible values used for BCR configuration struct
 */

/*! @enum BCR_CFG_DEBUG_ACCESS */
typedef enum {
	/*! AHB-AP, ET-AP, PWR-AP are enabled */
	BCR_CFG_DEBUG_ACCESS_EN = 0xAABBU,
	/*! AHB-AP, ET-AP, PWR-AP are enabled with password through DSSM */
	BCR_CFG_DEBUG_ACCESS_EN_PW = 0xCCDDU,
	/*! AHB-AP, ET-AP, PWR-AP are disabled */
	BCR_CFG_DEBUG_ACCESS_DIS = 0xFFFFU,
} BCR_CFG_DEBUG_ACCESS;

/*! @enum BCR_CFG_SWDP_MODE */
typedef enum {
	/*! SWD port access is enabled */
	BCR_CFG_SWDP_EN = 0xAABBU,
	/*! SWD port access is disabled */
	BCR_CFG_SWDP_DIS = 0xFFFFU,
} BCR_CFG_SWDP_MODE;

/*! @enum BCR_CFG_TIFA_MODE */
typedef enum {
	/*! If enabled, re-test request through DSSM is serviced */
	BCR_CFG_TIFA_EN = 0xAABBU,
	/*! Re-test request through DSSM is not serviced */
	BCR_CFG_TIFA_DIS = 0xFFFFU,
} BCR_CFG_TIFA_MODE;

/*! @enum BCR_CFG_BSL_PIN_INVOKE */
typedef enum {
	/*! GPIO based BSL invocation check will be executed */
	BCR_CFG_BSL_PIN_INVOKE_EN = 0xAABBU,
	/*! GPIO based BSL invocation check will not be executed */
	BCR_CFG_BSL_PIN_INVOKE_DIS = 0xFFFFU,
} BCR_CFG_BSL_PIN_INVOKE;

/*! @enum BCR_CFG_DEBUG_HOLD_MODE */
typedef enum {
	/*! Controls the release of debug access until INITDONE is issued */
	BCR_CFG_DEBUG_HOLD_EN = 0xFFFFU,
	/*! Does not control the release of debug access until INITDONE is issued */
	BCR_CFG_DEBUG_HOLD_DIS = 0xAABBU,
} BCR_CFG_DEBUG_HOLD_MODE;

/*! @enum BCR_CFG_CSC_MODE */
typedef enum {
	/*! Enable the CSC policy in SYSCTL */
	BCR_CFG_CSC_EXIST = 0xFFFFU,
	/*! Disable the CSC policy in SYSCTL */
	BCR_CFG_CSC_NOT_EXIST = 0xAABBU,
} BCR_CFG_CSC_MODE;

/*! @enum BCR_CFG_FLASH_BS_MODE */
typedef enum {
	/*! Enable the Flash Bank Swap Policy in SYSCTL */
	BCR_CFG_FLASH_BS_EN = 0xFFFFU,
	/*! Disable the Flash Bank Swap Policy in SYSCTL */
	BCR_CFG_FLASH_BS_DIS = 0xAABBU,
} BCR_CFG_FLASH_BS_MODE;

/*! @enum BCR_CFG_FAST_BOOT */
typedef enum {
	/*! If enabled, checks only the register invoke condition and skips other
	 *  BSL invoke conditions */
	BCR_CFG_FAST_BOOT_EN = 0xAABBU,
	/*! If disabled, all enabled BSL invoke conditions are evaluated */
	BCR_CFG_FAST_BOOT_DIS = 0xFFFFU,
} BCR_CFG_FAST_BOOT;

/*! @enum BCR_CFG_BOOTLOADER_MODE */
typedef enum {
	/*! Enable Bootloader mode */
	BCR_CFG_BOOTLOADER_MODE_EN = 0xAABBU,
	/*! Disable Bootloader mode */
	BCR_CFG_BOOTLOADER_MODE_DIS = 0xFFFFU,
} BCR_CFG_BOOTLOADER_MODE;

/*! @enum BCR_CFG_MASS_ERASE */
typedef enum {
	/*! Enable Mass Erase without password */
	BCR_CFG_MASS_ERASE_EN = 0xAABBU,
	/*! Enable Mass Erase with password */
	BCR_CFG_MASS_ERASE_EN_PW = 0xCCDDU,
	/*! Disable Mass Erase */
	BCR_CFG_MASS_ERASE_DIS = 0xFFFFU,
} BCR_CFG_MASS_ERASE;

/*! @enum BCR_CFG_FACTORY_RESET */
typedef enum {
	/*! Enable Factory Reset without password */
	BCR_CFG_FACTORY_RESET_EN = 0xAABBU,
	/*! Enable Factory Reset with password */
	BCR_CFG_FACTORY_RESET_EN_PW = 0xCCDDU,
	/*! Disable Factory Reset */
	BCR_CFG_FACTORY_RESET_DIS = 0xFFFFU,
} BCR_CFG_FACTORY_RESET;

/*! @enum BCR_CFG_NON_MAIN_STATIC_PROT */
typedef enum {
	/*! Enable static write protection for non-main memory */
	BCR_CFG_NON_MAIN_STATIC_PROT_EN = 0xFFFFU,
	/*! Disable static write protection for non-main memory */
	BCR_CFG_NON_MAIN_STATIC_PROT_DIS = 0xAABBU,
} BCR_CFG_NON_MAIN_STATIC_PROT;

/*! @enum BCR_CFG_SECURE_BOOT */
typedef enum {
	/*! Enable CRC check part of application */
	BCR_CFG_SECURE_BOOT_EN = 0xAABBU,
	/*! Enable Hash check part of application */
	BCR_CFG_SECURE_BOOT_HASH_EN = 0xCCDDU,
	/*! Disable application check */
	BCR_CFG_SECURE_BOOT_DIS = 0xFFFFU,
} BCR_CFG_SECURE_BOOT;

/* Bootcode user configuration structure */
typedef struct
{
	/*! Configuration signature */
	uint32_t bcrConfigID;
	/*! Enable/disable AHB-AP, ET-AP, PWR-AP.
	 * One of @ref BCR_CFG_DEBUG_ACCESS */
	BCR_CFG_DEBUG_ACCESS debugAccess;
	/*! Enable/disable SWD port access. One of @ref BCR_CFG_SWDP_MODE */
	BCR_CFG_SWDP_MODE swdpMode;
	/*! Enable/disable servicing re-test request through DSSM.
	 * One of @ref BCR_CFG_TIFA_MODE */
	BCR_CFG_TIFA_MODE tifaMode;
	/*! Enable/disable BSL pin invocation.
	 * One of @ref BCR_CFG_BSL_PIN_INVOKE */
	BCR_CFG_BSL_PIN_INVOKE bslPinInvokeEnable;
	/*! Programs static write protection of first 32K bytes.
	 * One bit corresponds to one sector, LSB is Sector 0. Setting a bit
	 * to 0 disables write, setting a bit to 1 enables write Possible values:
	 *    - 0x0 to 0xFFFFFFFF */
	uint32_t staticWriteProtectionMainLow;
	/*! Programs static write protection of first 32K bytes.
	 * One bit corresponds to eight sectors. Setting a bit
	 * to 0 disables write, setting a bit to 1 enables write Possible values:
	 *    - 0x0 to 0xFFFFFFF0 */
	uint32_t staticWriteProtectionMainHigh;
	/*! Non Main Flash Static Write Protection.
	 * One of @ref BCR_CFG_NON_MAIN_STATIC_PROT */
	BCR_CFG_NON_MAIN_STATIC_PROT staticWriteProtectionNonMain;
	/*! debugHold*/
	uint16_t  debugHold;
	/*! CSCexist*/
	uint16_t CSCexist;
	/*! flashBankSwapPolicy*/
	uint16_t flashBankSwapPolicy;
	/*! The fast boot mode. One of @ref BCR_CFG_FAST_BOOT*/
	BCR_CFG_FAST_BOOT fastBootMode;
	/*! The bootloader mode. One of @ref BCR_CFG_BOOTLOADER_MODE */
	BCR_CFG_BOOTLOADER_MODE bootloaderMode;
	/*! The mass erase mode. One of @ref BCR_CFG_MASS_ERASE */
	BCR_CFG_MASS_ERASE massEraseMode;
	/*! The factory reset mode. One of @ref BCR_CFG_FACTORY_RESET */
	BCR_CFG_FACTORY_RESET factoryResetMode;
	/*! DSSM_BC_MASS_ERASE_REQUEST, DSSM_DATA_EXCHANGE */
	uint32_t passwordMassErase [PASSWORD_WORD_LEN];
	/*! DSSM_BC_FACTORY_RESET_REQUEST, DSSM_DATA_EXCHANGE */
	uint32_t passwordFactoryReset [PASSWORD_WORD_LEN];
	/*! Used with Command DSSM_BC_PW_AUTH_REQUEST */
	uint32_t passwordDebugLock [PASSWORD_WORD_LEN];
	/*! Reserved for word alignment */
	uint16_t bc_reserved_0;
	/*! CRC check part of the application. One of @ref BCR_CFG_SECURE_BOOT */
	BCR_CFG_SECURE_BOOT secureBootMode;
	/*! The Starting address from where CRC has to be calculated for the application */
	uint32_t userSecureAppStartAddr;
	/*! The Length of the application for which CRC is calculated */
	uint32_t userSecureAppLength;
	/*! userSecureAppHash*/
	uint32_t userSecureAppHash [PASSWORD_WORD_LEN];
	/*! Reserved for word alignment */
	uint32_t bc_reserved_1;
	/*! CRC-32 of this structure*/
	uint32_t userCfgCRC;
} BCR_Config;

/* Structure to store the Bootloader UART and I2C Pin details. */
typedef struct
{
	uint8_t UART_RXD_pad_num;
	uint8_t UART_RXD_PF_mux_sel;
	uint8_t UART_TXD_pad_num;
	uint8_t UART_TXD_PF_mux_sel;
	uint8_t I2C_SDA_pad_num;
	uint8_t I2C_SDA_PF_mux_sel;
	uint8_t I2C_SCL_pad_num;
	uint8_t I2C_SCL_PF_mux_sel;
} BSLInterfacePins;

/* Structure to store the Bootloader invocation Pin details.
 * This structure is followed in TRIM memory where default BSL invocation
 * pin details are stored and also in Bootloader configuration memory.
 * See BSL_CFG_INVOKE_PIN defines for more details on mask widths and offsets.
 *
 * Pin_data_0
 * pincmIndex   -> IOMUX_SECCFG_PINCM index for the pin. See device datasheet
 *                 for index range
 * pinLevel     -> Pin state High(1)/ Low(0) which should be
 *                 considered as BSL invocation condition
 * Pin_data_1
 * gpioNum      -> GPIO Pin number (0 to 31)
 * gpioBase     -> GPIO Instance number (GPIO Base Index or GPIO Port). See
 *                 device datasheet for ports available on the device. Port A
 *                 is 0, port B is 1, etc.
 */
typedef struct
{
	uint8_t pinData0;
	uint8_t pinData1;
} BSLInvokePin;

/**
 * @brief Possible values used for BSL configuration struct
 */

/*! Mask for BSLInvokePin.pinData0 to get IOMUX_PINCM */
#define BSL_CFG_INVOKE_PIN_PINCM_INDEX_MASK                             (0x7FU)
#define BSL_CFG_INVOKE_PIN_PINCM_INDEX_POS                                 (0U)

/*! Mask for BSLInvokePin.pinData0 to get the pin state, which determines the
 * Bootloader invocation condition) */
#define BSL_CFG_INVOKE_PIN_LEVEL_MASK                                   (0x80U)
#define BSL_CFG_INVOKE_PIN_LEVEL_POS                                       (7U)

/*! Mask for BSLInvokePin.pinData1 to get GPIO pin number */
#define BSL_CFG_INVOKE_PIN_GPIO_PIN_NUM_MASK                            (0x1FU)
#define BSL_CFG_INVOKE_PIN_GPIO_PIN_NUM_POS                                (0U)

/*! Mask for BSLInvokePin.pinData1 to get GPIO Base Index */
#define BSL_CFG_INVOKE_PIN_GPIO_PORT_NUM_MASK                           (0x60U)
#define BSL_CFG_INVOKE_PIN_GPIO_PORT_NUM_POS                               (5U)

/*! @enum BSL_CFG_MEMORY_READOUT */
typedef enum {
	/*! Memory readout is enabled */
	BSL_CFG_MEMORY_READOUT_ENABLE = 0xAABBU,
	/*! Memory readout is disabled */
	BSL_CFG_MEMORY_READOUT_DISABLE = 0xFFFFU,
} BSL_CFG_MEMORY_READOUT;

/*! @enum BSL_CFG_NRST */
typedef enum {
	/*! NRST is disabled during bootloader execution */
	BSL_CFG_NRST_DISABLE = 0xAABBU,
	/*! NRST is enabled during bootloader execution */
	BSL_CFG_NRST_ENABLE = 0xFFFFU,
} BSL_CFG_NRST;

/*! @enum BSL_CFG_PLUGIN_TYPE */
typedef enum {
	/*! Plugin type in Flash is UART */
	BSL_CFG_PLUGIN_TYPE_UART = 0x1000U,
	/*! Plugin type in Flash is I2C */
	BSL_CFG_PLUGIN_TYPE_I2C = 0x2000U,
	/*! Any other interface with valid hooks will be added to the plugin
	 * list */
	BSL_CFG_PLUGIN_TYPE_ANY = 0xFFFFU,
} BSL_CFG_PLUGIN_TYPE;

/*! @enum BSL_CFG_PLUGIN_FLASH */
typedef enum {
	/*! Flash plugin will be used */
	BSL_CFG_PLUGIN_FLASH_EXIST = 0xBBU,
	/*! Only ROM plugins will be used */
	BSL_CFG_PLUGIN_FLASH_NOT_EXIST = 0xFFU,
} BSL_CFG_PLUGIN_FLASH;

/*! @enum BSL_CFG_FLASH_BSL */
typedef enum {
	/*! Secondary BSL does exist */
	BSL_CFG_FLASH_BSL_EXIST = 0xAABBU,
	/*! Secondary BSL does not exist */
	BSL_CFG_FLASH_BSL_NOT_EXIST = 0xFFFFU,
} BSL_CFG_FLASH_BSL;

/*! @enum BSL_CFG_SECURITY */
typedef enum {
	/*! Factory reset performed on security alert */
	BSL_CFG_SECURITY_FACTORY_RESET = 0xAABBU,
	/*! BSL disabled on security alert */
	BSL_CFG_SECURITY_DISABLE_BSL = 0xCCDDU,
	/*! Ignore security alert */
	BSL_CFG_SECURITY_IGNORE = 0xFFFFU,
} BSL_CFG_SECURITY;

/**
 * @brief Bootstrap loader (BSL) configuration structure values.
 * See BSL_CFG defines for possible values.
 */
typedef struct
{
	/*! Predetermined config signature magic ID */
	uint32_t configID;
	/*! BSL interface pins. Static Default BSL invocation Pin details are
	 * as per TRIM open AREA default. */
	BSLInterfacePins interfacePins;
	/*! BSL pin invocation. Static Default BSL invocation Pin details are
	 * as per TRIM open Area default. */
	BSLInvokePin pin;
	/*! Enable/disable memory readout. One of @ref BSL_CFG_MEMORY_READOUT */
	BSL_CFG_MEMORY_READOUT memoryRead;
	/*! Bootloader 64-byte password */
	uint32_t password[8];
	/*! Plugin type. One of @ref BSL_CFG_PLUGIN_TYPE */
	BSL_CFG_PLUGIN_TYPE pluginType;
	/*! Enable use of Flash plugin or ROM plugin.
	 * One of @ref BSL_CFG_PLUGIN_FLASH */
	BSL_CFG_PLUGIN_FLASH flashPluginEnable;
	/*! SRAM memory consumed by the Flash Plugin. Range from 0x00 to 0xFF*/
	uint8_t pluginSramSize;
	/*! Function pointers for Flash Plugins.
	 *   - Byte [3-0] : Init
	 *   - Byte [7-4] : Receive
	 *   - Byte [11-8] : Send
	 *   - Byte [15-12] : Deinit */
	uint32_t pluginHook[4];
	/*! ID field to enable invocation of an alternate BSL.
	 * One of @ref BSL_CFG_FLASH_BSL */
	BSL_CFG_FLASH_BSL  BSLAlternateConfig;
	/*! Reserved */
	uint16_t reserved;
	/*! Address of the alternate BSL */
	uint32_t  BSLAlternateAddr;
	/*! Pointer to the version information in MAIN flash. Possible values:
	 *    - Valid Flash Address
	 *    - All other values: Address will not be accessed */
	uint32_t* appRev;
	/*! Security alert configuration. One of @ref BSL_CFG_SECURITY */
	BSL_CFG_SECURITY securityAlert;
	/* I2C slave address to be used for BSL I2C communication. Any 7-bit value */
	uint16_t i2cSlaveAddress;
	/*! CRC of this BSL_Config structure */
	uint32_t userCfgCRC;
} BSL_Config;

/* Added for secondary_bsl to build */
extern const BSL_Config BSLConfig;
extern const BCR_Config BCRConfig;

#endif /* boot_config_l_h */
```
